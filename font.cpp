#include "font.h"


//================================================
// 16x16 中文点阵
// Unicode编码
//================================================


// 有 U+6709

const uint8_t FONT_YOU[32] PROGMEM =
{
0x02,0x00,
0x02,0x00,
0xff,0xfe,
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0x08,0x20
};



// 线 U+7EBF

const uint8_t FONT_XIAN[32] PROGMEM =
{
0x10, 0x50,
0x10,0x48,
0x20,0x40,
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0x00,0x02
};



// 电 U+7535

const uint8_t FONT_DIAN[32] PROGMEM =
{
0x01,0x00,
0x01,0x00,
0x01,0x00,
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0x00,0xfe
};



// 视 U+89C6

const uint8_t FONT_SHI[32] PROGMEM =
{
0x20,0x00,
0x11,0xfc,
0x11,0x04,
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0x14,0x0e
};



// 流 U+6D41

const uint8_t FONT_LIU[32] PROGMEM =
{
0x00,0x80,
0x20,0x40,
0x17,0xfe,
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0x08,0x46
};


//================================================
// 媒 U+5A92
//================================================

const uint8_t FONT_MEI[32] PROGMEM =
{
0x10,0x88,
0x10,0x88,
0x13,0xfe,
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0x00,0x20
};



//================================================
// 体 U+4F53
//================================================

const uint8_t FONT_TI[32] PROGMEM =
{
0x08,0x40,
0x08,0x40,
0x08,0x40,
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0x10,0x40
};



//================================================
// 数 U+6570
//================================================

const uint8_t FONT_SHU[32] PROGMEM =
{
0x08,0x20,
0x49,0x20,
0x2a,0x20,
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0xc2,0x82
};



//================================================
// 播 U+64AD
//================================================

const uint8_t FONT_BO[32] PROGMEM =
{
0x20,0x78,
0x27,0xc0,
0x22,0x48,
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0x42,0x08
};



//================================================
// 卡 U+5361
//================================================

const uint8_t FONT_KA[32] PROGMEM =
{
0x02,0x00,
0x02,0x00,
0x03,0xf8,
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0x02,0x00
};



//================================================
// 拉 U+62C9
//================================================

const uint8_t FONT_LA[32] PROGMEM =
{
0x10,0x40,
0x10,0x20,
0x10,0x20,
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0x20,0x00
};


//================================================
// 关 U+5173
//================================================

const uint8_t FONT_GUAN[32] PROGMEM =
{
0x10,0x10,
0x08,0x10,
0x08,0x20,
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0xc0,0x06
};



//================================================
// 机 U+673A
//================================================

const uint8_t FONT_JI[32] PROGMEM =
{
0x10,0x00,
0x11,0xf0,
0x11,0x10,
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0x14,0x00
};



//================================================
// 字库索引表
//================================================

ChineseFont fontTable[] =
{

    {0x6709, FONT_YOU},       // 有
    {0x7EBF, FONT_XIAN},      // 线
    {0x7535, FONT_DIAN},      // 电
    {0x89C6, FONT_SHI},       // 视

    {0x6D41, FONT_LIU},       // 流
    {0x5A92, FONT_MEI},       // 媒
    {0x4F53, FONT_TI},        // 体

    {0x6570, FONT_SHU},       // 数
    {0x64AD, FONT_BO},        // 播

    {0x5361, FONT_KA},        // 卡
    {0x62C9, FONT_LA},        // 拉

    {0x5173, FONT_GUAN},      // 关
    {0x673A, FONT_JI}         // 机

};


const int fontCount =
sizeof(fontTable)/sizeof(fontTable[0]);




//================================================
// 查找字体
//================================================

const uint8_t *FindFont(uint16_t code)
{

    for(int i=0;i<fontCount;i++)
    {

        if(fontTable[i].unicode == code)
        {
            return fontTable[i].bitmap;
        }

    }

    return nullptr;

}




//================================================
// UTF-8转换Unicode
//================================================

uint16_t UTF8Decode(
    const char *str,
    int &length
)
{

    uint8_t c = str[0];


    if(c < 0x80)
    {

        length = 1;

        return c;

    }
    else if((c & 0xE0)==0xC0)
    {

        length = 2;

        return

        ((str[0]&0x1F)<<6)
        |
        (str[1]&0x3F);

    }
    else
    {

        length = 3;

        return

        ((str[0]&0x0F)<<12)
        |
        ((str[1]&0x3F)<<6)
        |
        (str[2]&0x3F);

    }

}





//================================================
// 绘制16×16中文
//================================================

void DrawChinese16(

    Arduino_GFX *gfx,

    int x,

    int y,

    const char *text,

    uint16_t color

)
{

    while(*text)
    {

        int len;


        uint16_t code =
        UTF8Decode(
            text,
            len
        );


        const uint8_t *font =
        FindFont(code);



        if(font)
        {

            for(int row=0; row<16; row++)
            {

                uint16_t line;


                // ESP32读取PROGMEM

                line =
                ((uint16_t)pgm_read_byte(
                    font + row*2
                ) << 8)
                |
                pgm_read_byte(
                    font + row*2 + 1
                );



                for(int col=0; col<16; col++)
                {

                    if(line & (0x8000 >> col))
                    {

                        gfx->drawPixel(

                            x + col,

                            y + row,

                            color

                        );

                    }

                }

            }

        }


        x += 16;

        text += len;

    }

}




//================================================
// 文字宽度计算
//================================================

int GetMixedWidth(
    const char *text
)
{

    int width=0;


    while(*text)
    {

        if((uint8_t)*text >= 0x80)
        {

            width += 16;

            text += 3;

        }
        else
        {

            width += 8;

            text++;

        }

    }


    return width;

}